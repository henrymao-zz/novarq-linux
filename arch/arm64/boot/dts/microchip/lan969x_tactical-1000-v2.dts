// SPDX-License-Identifier: GPL-2.0-or-later OR MIT

/dts-v1/;

#include "lan969x_tactical-1000.dtsi"

/ {
	model = "Novarq Tactical 1000 v2";
	compatible = "novarq,tactical-1000-v2", "microchip,lan969x";
};
